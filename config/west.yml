## config/west.yml
```yaml
manifest:
  remotes:
    - name: zmkfirmware
      url-base: https://github.com/malinges
  projects:
    - name: zmk
      remote: zmkfirmware
      revision: workspace
      import: app/west.yml
  self:
    path: config
```
